## Kconfig.patch
```kconfig
--- bak.Kconfig	2017-11-16 10:20:16.372329419 +0100
+++ Kconfig	2017-11-16 11:12:15.400329047 +0100
@@ -211,6 +211,7 @@
 source security/apparmor/Kconfig
 source security/loadpin/Kconfig
 source security/yama/Kconfig
+source security/therestrictor/Kconfig
 
 source security/integrity/Kconfig
 
@@ -238,6 +239,9 @@
 	config DEFAULT_SECURITY_APPARMOR
 		bool "AppArmor" if SECURITY_APPARMOR=y
 
+	config DEFAULT_SECURITY_THEREST
+		bool "The RESTRICTOR" if SECURITY_THEREST=y
+
 	config DEFAULT_SECURITY_DAC
 		bool "Unix Discretionary Access Controls"
 
@@ -249,6 +253,7 @@
 	default "smack" if DEFAULT_SECURITY_SMACK
 	default "tomoyo" if DEFAULT_SECURITY_TOMOYO
 	default "apparmor" if DEFAULT_SECURITY_APPARMOR
+	default "therest" if DEFAULT_SECURITY_THEREST
 	default "" if DEFAULT_SECURITY_DAC
 
 endmenu
```

## kernel/dropkin/Kconfig
```kconfig
config SECURITY_DROPKIN
	bool "Dropkin Security Module"
	depends on SECURITY
	default n
	help
	  This selects the Dropkin Security Module.
	  Dropkin allows processes to securely drop priviliges in a
	  way, that does not allow an attacker to recover them.

config SECURITY_DROPKIN_DEVEL
	bool "Dropkin's Weird debug mode. Kernel panic!!!"
	depends on SECURITY
	default n
	help
	  Seriously, you MUST NOT enable that! It causes kernel panics!!!

config SECURITY_DROPKIN_NETFILTER
	bool "Dropkin's Netfilter extension."
	depends on SECURITY
	depends on SECURITY_DROPKIN
	depends on NETFILTER
	default y
	help
	  This enables dropkin's netfilter hook. This causes Dropkin to enforce
	  the SECF_NO_NETWORKING secureflag on egress-packets as well.
```

## kernel/therestrictor/Kconfig
```kconfig
config SECURITY_THEREST
	bool "The RESTRICTOR Linux Security Module"
	depends on SECURITY
	default y
	help
	  This is a Security Module designed to offer security features
	  that make the live of intruders harder, or even, to make instrusions
	  impossible.
```
